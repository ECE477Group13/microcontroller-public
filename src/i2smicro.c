#include "i2smicro.h"
#include "string.h"

#define TAG "I2S"
#define WAV = ".wav"

i2s_chan_handle_t tx_handle;


/*************************************************
Function Description:
    Initialize the i2s channel
Function Arguments:
    N/A
*************************************************/
void init_i2s_tx() {

    /* Get the default channel configuration by the helper macro.
    It can help to specify the I2S role and port ID */
    i2s_chan_config_t chan_cfg = I2S_CHANNEL_DEFAULT_CONFIG(I2S_NUM_AUTO, I2S_ROLE_MASTER);

    /* Allocate a new TX channel and get the handle of this channel */
    i2s_new_channel(&chan_cfg, &tx_handle, NULL);

    /* Setting the configurations, the slot configuration and clock configuration can be generated by the macros
    * These two helper macros are defined in 'i2s_std.h' which can only be used in STD mode.
    * They can help to specify the slot and clock configurations for initialization or updating */
    i2s_std_config_t std_cfg = {
        .clk_cfg = {
            .sample_rate_hz = 44100,
            .clk_src = I2S_CLK_SRC_PLL_160M,
            .mclk_multiple = I2S_MCLK_MULTIPLE_256,
        },
        .slot_cfg = I2S_STD_PHILIPS_SLOT_DEFAULT_CONFIG(I2S_DATA_BIT_WIDTH_16BIT, I2S_SLOT_MODE_STEREO),
        .gpio_cfg = {
            .mclk = I2S_GPIO_UNUSED, 
            .bclk = I2S_BCLK, 
            .ws = I2S_LRC, 
            .dout = I2S_DOUT,
            .din = I2S_GPIO_UNUSED, 
            .invert_flags = {
                .mclk_inv = false,
                .bclk_inv = false,
                .ws_inv = false,
            },
        },
    };

    /* Initialize i2s channel to standard mode*/
    i2s_channel_init_std_mode(tx_handle, &std_cfg);    

    ESP_LOGI(TAG, "I2S Initialized.");

}


/*************************************************
Function Description:
    Destroy/disable the i2s channel
Function Arguments:
    N/A
*************************************************/
void destroy_i2s_tx(){

    /* Safety check - make sure channel is disabled */
    i2s_channel_disable(tx_handle);

    /* If the handle is not needed any more, delete it to release the channel resources */
    i2s_del_channel(tx_handle);

    ESP_LOGI(TAG, "I2S Destroyed.");
}


/*************************************************
Function Description:
    Play wav file from SD card
Function Arguments:
    const char* fp - file path including mounting
                     point. MUST be .wave file.
                     Ex) "/sdcard/wave1.wav"
*************************************************/
esp_err_t play_wav_i2s(const char *fp)
{
    FILE *fh = fopen(fp, "rb");
    if (fh == NULL)
    {
        ESP_LOGI(TAG, "FAILED to open SD file.");
        return ESP_ERR_INVALID_ARG;
    }

    // Get the length of the string
    size_t len = strlen(fp);

    // Check if the string ends with ".wav"
    if (strcmp(fp + len - 4, ".wav") != 0) {
        ESP_LOGI(TAG, "INVALID file - not .wav");
        return ESP_ERR_INVALID_ARG;
    }

    /* skip the header... */
    fseek(fh, 44, SEEK_SET);

    /* create a writer buffer */
    int16_t *buf = calloc(AUDIO_BUFFER, sizeof(int16_t));
    size_t bytes_read = 0;
    size_t bytes_written = 0;

    bytes_read = fread(buf, sizeof(int16_t), AUDIO_BUFFER, fh);

    if (i2s_channel_enable(tx_handle) != ESP_OK) {
        ESP_LOGI(TAG, "FAILED to enable I2S channel.");
    }

    /* play file */
    while (bytes_read > 0) {
        /* write the buffer to the i2s */
        i2s_channel_write(tx_handle, buf, bytes_read * sizeof(int16_t), &bytes_written, portMAX_DELAY);
        bytes_read = fread(buf, sizeof(int16_t), AUDIO_BUFFER, fh);
    }

    i2s_channel_disable(tx_handle);
    free(buf);

    return ESP_OK;
}